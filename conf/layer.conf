## conf/layer.conf
```bitbake
# We have a conf and classes directory, add to BBPATH
BBPATH .= ":${LAYERDIR}"

# We have recipes-* directories, add to BBFILES
BBFILES += "${LAYERDIR}/recipes-*/*/*.bb \
	${LAYERDIR}/recipes-*/*/*.bbappend"

BBFILE_COLLECTIONS += "stm32f7x"
BBFILE_PATTERN_stm32f7x  = "^${LAYERDIR}/"
BBFILE_PRIORITY_stm32f7x = "10"

LAYERSERIES_COMPAT_stm32f7x = "kirkstone"

# Set variable to get the location of the layer
STM32F7X_BASE := '${LAYERDIR}'
```

## conf/machine/stm32f769-disco.conf
```bitbake
#@TYPE: Machine
#@NAME: stm32f769-disco
#@DESCRIPTION: Machine configuration for the stm32f769-disco
#@MAINTAINER: Ayoub Zaki <ayoub.zaki@embetrix.com>

require conf/machine/include/arm/armv7m/tune-cortexm7.inc
require conf/machine/include/soc-family.inc

TCLIBC = "musl"
SOC_FAMILY = "stm32f7x"

PREFERRED_PROVIDER_virtual/kernel = "linux-mainline"


UBOOT_ENTRYPOINT      = "0xC0000000"
UBOOT_DTB_LOADADDRESS = "0xC0300000"

SERIAL_CONSOLES       = "115200;ttySTM0"
SERIAL_CONSOLES_CHECK = "${SERIAL_CONSOLES}"

KERNEL_CLASSES  += "kernel-fitimage"
KERNEL_IMAGETYPE = "fitImage"

# Ship a kernel with bundled initramfs
INITRAMFS_IMAGE ?= "stm32f7x-initramfs-image"
INITRAMFS_IMAGE_BUNDLE ?= "1"

# Kernel
KERNEL_DEVICETREE ?= "${MACHINE}.dtb"

# U-Boot
UBOOT_MACHINE     ?= "${MACHINE}_defconfig"
UBOOT_DEVICETREE  ?= "${MACHINE}"
UBOOT_MAKE_TARGET ?= "DEVICE_TREE=${UBOOT_DEVICETREE} all"

MACHINE_FEATURES  = ""

# Preferred providers
PREFERRED_PROVIDER_u-boot-fw-utils = "libubootenv"

#MACHINE_EXTRA_RRECOMMENDS += "u-boot-fw-utils"

# Wic default support
WKS_FILE ?= "stm32f7x.wks"

#IMAGE_FSTYPES  ?= "tar.bz2 wic.gz wic.bmap"
```

## wic/stm32f7x.wks
```
# long-description: Creates a partitioned SD card image for stm32f7x.

part /     --source rootfs  --ondisk mmcblk --fstype=ext4  --label root --align 4096 --size 512M

bootloader --ptable gpt
```
